## CMakeLists.txt
```
cmake_minimum_required(VERSION 3.8.2)
find_package(Zephyr REQUIRED HINTS $ENV{ZEPHYR_BASE})
project(playground_app)

target_sources(app PRIVATE src/main.c) # app is defined in zephyr/cmake/app/boilerplate.cmake
```

## west.yml
```
# The west manifest file (west.yml) for the demo application
#
# See the west documentation for more information:
#
# https://developer.nordicsemi.com/nRF_Connect_SDK/doc/latest/zephyr/guides/west/index.html

manifest:
  # This west.yml requires west 0.12s or later, because the "import"
  # feature used below was introduced then.
  version: 0.12

  # "projects" is a list of git repositories which make up the NCS
  # source code.
  projects:
    # v2.6.2 seems to be the last version before sysbuild was introduced
    - name: nrf
      url: https://github.com/nrfconnect/sdk-nrf
      revision: v2.6.2
      import: true

  self:
    # This repository should be cloned to application.
    path: application
```

## prj.conf
```kconfig
# Stacks and heaps
CONFIG_MAIN_STACK_SIZE=3072
CONFIG_HEAP_MEM_POOL_SIZE=16384

CONFIG_BOOTLOADER_MCUBOOT=y

# Logging via RTT
CONFIG_LOG=y
CONFIG_USE_SEGGER_RTT=y
CONFIG_LOG_BACKEND_RTT=y
# Tracing via SEGGER SYSTEMVIEW
CONFIG_TRACING=y
CONFIG_SEGGER_SYSTEMVIEW=y

# newlibc
CONFIG_NEWLIB_LIBC=y

CONFIG_NO_OPTIMIZATIONS=y
#CONFIG_DEBUG_OPTIMIZATIONS=y

# Add information for debugging
CONFIG_DEBUG_THREAD_INFO=y
```

## src/main.c
```c
#include <zephyr/kernel.h>
#include <zephyr/logging/log.h>

LOG_MODULE_REGISTER(main);

int main(void) {
  while (1) {
    k_msleep(1000);
    LOG_INF(".");
  }

  return 0;
}
```
